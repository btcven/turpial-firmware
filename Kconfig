## Kconfig
```kconfig
menu "Turpial Firmware configuration"

rsource "sys/Kconfig"

menuconfig TURPIAL_STATIC_ADDRESS
    bool "Use static address"
    default n
    help
        Configure an static address, useful for development.

if TURPIAL_STATIC_ADDRESS

config TURPIAL_STATIC_GLOBAL_ADDR
    string "IPv6 global address"
    default "fc00:db8::1"
    help
        Turpial default IPv6 global address

endif

config TURPIAL_GLOBAL_PREFIX
    int "Prefix in bits for Turpial global address"
    default 64
    help
        Global prefix in bits for Turpial global address

endmenu
```

## boards/turpial-cc1312/Kconfig
```kconfig
# Copyright (c) 2021 btcven and Locha Mesh developers <contact@locha.io>
#
# This file is subject to the terms and conditions of the GNU Lesser
# General Public License v2.1. See the file LICENSE in the top level
# directory for more details.
#

config BOARD
    default "turpial-cc1312" if BOARD_TURPIAL_CC1312

config BOARD_TURPIAL_CC1312
    bool
    default y
    select CPU_MODEL_CC1312R1F3
    select HAS_PERIPH_I2C
    select HAS_PERIPH_GPIO
    select HAS_PERIPH_GPIO_IRQ
    select HAS_PERIPH_TIMER
    select HAS_PERIPH_UART
```

## boards/turpial-esp32/Kconfig
```kconfig
# Copyright (c) 2021 btcven and Locha Mesh developers
#
# This file is subject to the terms and conditions of the GNU Lesser
# General Public License v2.1. See the file LICENSE in the top level
# directory for more details.

config BOARD
    default "turpial-esp32" if BOARD_TURPIAL_ESP32

config BOARD_TURPIAL_ESP32
    bool
    default y
    select BOARD_COMMON_ESP32
    select CPU_MODEL_ESP32_WROVER
    select HAS_ESP_RTC_TIMER_32K
    select HAS_ESP_SPI_RAM
    select HAS_PERIPH_ADC
    select HAS_PERIPH_I2C
    select HAS_PERIPH_PWM
    select HAS_PERIPH_SPI
    select HAS_ARDUINO

source "$(RIOTBOARD)/common/esp32/Kconfig"
```

## components/Network/Kconfig
```kconfig
menu "Network Configuration (Turpial)"

menuconfig RADIO_SLIP
    bool "Radio SLIP configuration"
    default y
    help
        Radio SLIP configuration.

if RADIO_SLIP

config RADIO_SLIP_UART
    int "UART device to use for the radio"
    default 1
    range 0 2
    help
        UART device to use for the radio.

config RADIO_SLIP_TX
    int "GPIO to use for the TX pin"
    default 21 
    range 0 31
    help
        This is the GPIO that is going to be used for the SLIP TX pin.

config RADIO_SLIP_RX
    int "GPIO to use for the RX pin"
    default 22
    range 0 31
    help
        This is the GPIO that is going to be used for the SLIP RX pin.

config RADIO_SLIP_BAUDRATE
    int "SLIP baudrate"
    default 115200
    range 9600 5000000
    help
        This is the baudrate used for the SLIP interface

endif

endmenu
```

## main/Kconfig.projbuild
```kconfig
menu "Turpial Firmware Configuration"

config DEVICE_NAME
    string "Device name"
    default "turpial"
    help
        "The device name"

config DEVICE_VERSION
    string "Device version"
    default "v0.1.0"
    help
        "Current firmware version"

menuconfig ESC_ENABLED
    bool "ESC subsystem"
    default y
    help
        "Configure the ESC subsystem (BQ27441g)"

if ESC_ENABLED

config ESC_MAX_BATTERY_CAPACITY
    int "Maximum battery capacity in mAh"
    default 2000
    help
        "Maximum battery capacity in mAh units"

config ESC_LOW_BATTERY_THRESHOLD
    int "Low battery threshold in %"
    default 20
    range 0 100
    help
        "Low battery threshold in %"

config ESC_CRITICAL_BAT_THRESHOLD
    int "Critical battery percentage threshold"
    default 7
    range 0 100
    help
        "Critical battery percentage threshold"

config ESC_GPOUT_PIN
    int "GPOUT signal pin"
    default 18
    range 0 32
    help
        "GPOUT signal pin number"

config ESC_SYSOFF_PIN
    int "SYSOFF signal pin"
    default 27
    range 0 32
    help
        "SYSOFF signal pin number"

config ESC_SOC_DELTA
    int "State-of-Charge delta value"
    default 1
    range 1 100
    help
        "State-of-Charge delta (change) value"

endif

menuconfig RADIO_SLIP
    bool "Enable radio SLIP network interface"
    default y
    help
        "Enable the SLIP network interface that connects to the CC1312 radio"

if RADIO_SLIP

config RADIO_SLIP_UART
    int "UART device to use for the radio"
    default 1
    range 0 2
    help
        "UART device to use for the radio"

config RADIO_SLIP_TX
    int "GPIO to use for the TX pin"
    default 8
    range 0 31
    help
        "This is the GPIO that is going to be used for the SLIP TX pin."

config RADIO_SLIP_RX
    int "GPIO to use for the RX pin"
    default 7
    range 0 31
    help
        "This is the GPIO that is going to be used for the SLIP RX pin."

config RADIO_SLIP_BAUDRATE
    int "SLIP baudrate"
    default 115200
    range 9600 5000000
    help
        "This is the baudrate used for the SLIP interface"

endif

endmenu
```

## mesh/Kconfig
```kconfig
# Copyright (C) 2020 Locha Inc

menu "Turpial - Radio Firmware Configuration"

rsource "sys/Kconfig"

endmenu
```

## mesh/sys/net/Kconfig
```kconfig
# Copyright (C) 2020 Locha Inc

menu "Network"

rsource "aodvv2/Kconfig"
rsource "vaina/Kconfig"

endmenu
```

## mesh/sys/net/aodvv2/Kconfig
```kconfig
menuconfig KCONFIG_MODULE_AODVV2
    bool "AODVv2 Routing Protocol"
    depends on MODULE_AODVV2

if KCONFIG_MODULE_AODVV2

rsource "Kconfig.timers"

config AODVV2_MCMSG_MAX_ENTRIES
    int "Maximum number of entries on the Multicast Message Set"
    default 16

config AODVV2_RCS_ENTRIES
    int "Configure maximum number of entries on the Router Client Set"
    default 2

config METRIC_HOP_COUNT_AODVV2_MAX
    int "Configure maximum value for Hop Count metric"
    default 255

config AODVV2_RFC5444_STACK_SIZE
    int "Configure stack size for RFC 5444 thread"
    default 2048

config AODVV2_RFC5444_PRIO
    int "Configure priority for RFC 5444 thread"
    default 6
    range 0 15

config AODVV2_RFC5444_MSG_QUEUE_SIZE
    int "Configure message queue size for RFC 5444 thread"
    default 32

config AODVV2_RFC5444_PACKET_SIZE
    int "Configure RFC 5444 maximum output packet size"
    default 128

config AODVV2_RFC5444_ADDR_TLVS_SIZE
    int "Configure RFC5444 address TLVs buffer size"
    default 1000

config AODVV2_MAX_ROUTING_ENTRIES
    int "Configure maximum number of routing entries"
    default 16

endif
```

## mesh/sys/net/aodvv2/Kconfig.timers
```kconfig
# Copyright (C) 2021 btcven and Locha Mesh developers
#
# This file is subject to the terms and conditions of the GNU Lesser
# General Public License v2.1. See the file LICENSE in the top level
# directory for more details.
#

menuconfig KCONFIG_AODVV2_TIMERS
    bool "Timers"
    default n

if KCONFIG_AODVV2_TIMERS

config AODVV2_ACTIVE_INTERVAL
    int "ACTIVE_INTERVAL"
    default 5

config AODVV2_MAX_IDLETIME
    int "MAX_IDLETIME"
    default 200

config AODVV2_MAX_BLACKLIST_TIME
    int "MAX_BLACKLIST_TIME"
    default 200

config AODVV2_MAX_SEQNUM_LIFETIME
    int "MAX_SEQNUM_LIFETIME"
    default 300

config AODVV2_RERR_TIMEOUT
    int "RERR_TIMEOUT"
    default 3

config AODVV2_RTEMSG_ENTRY_TIME
    int "RTEMSG_ENTRY_TIME"
    default 12

config AODVV2_RREQ_WAIT_TIME
    int "RREQ_WAIT_TIME"
    default 2

config AODVV2_RREP_ACK_SENT_TIMEOUT
    int "RREP_ACK_SENT_TIMEOUT"
    default 1

config AODVV2_RREQ_HOLDDOWN_TIME
    int "RREQ_HOLDDOWN_TIME"
    default 10

endif
```

## mesh/sys/net/vaina/Kconfig
```kconfig
menuconfig KCONFIG_MODULE_VAINA
    bool "VAINA - Versatile Address Interface | Network Administration"
    depends on MODULE_VAINA
    help
        Configures VAINA - Versatile Address Interface | Network Administration
        using Kconfig.

if KCONFIG_MODULE_VAINA

config VAINA_PORT
    int "Port used for the VAINA UDP server"
    default 1337
    range 0 65536
    help
        Port used for the VAINA UDP server

config VAINA_MCAST_ADDR
    string "VAINA multicast address"
    default "ff15::42"
    help
        Multicast address used for the VAINA server. This is where VAINA will
        listen to messages (that are sent to the correct configured port).

endif
```

## sdkconfig.defaults
```kconfig
#
# ESP-IDF SDK Configuration File.
# Locha Mesh - Turpial Firmware Project Configuration
#

#
# Partition Table
#
CONFIG_PARTITION_TABLE_CUSTOM=y
CONFIG_PARTITION_TABLE_CUSTOM_FILENAME="partitions_custom.csv"
CONFIG_PARTITION_TABLE_FILENAME="partitions_custom.csv"
# end of Partition Table

#
# SPI RAM options
#
CONFIG_ESP32_SPIRAM_SUPPORT=y
CONFIG_SPIRAM_BOOT_INIT=y
CONFIG_SPIRAM_USE_MALLOC=y
CONFIG_SPIRAM_TYPE_AUTO=y
# end of SPI RAM options

#
# HTTPS Server Config
#
CONFIG_ESP_HTTPS_SERVER_ENABLE=y
CONFIG_HTTPD_WS_SUPPORT=y
# end of HTTPS Server Config

#
# Serial Flasher Config
#
CONFIG_ESPTOOLPY_BAUD_OTHER_VAL=115200
CONFIG_ESPTOOLPY_FLASHSIZE_4MB=y
CONFIG_ESPTOOLPY_FLASHSIZE="4MB"
CONFIG_ESPTOOLPY_FLASHSIZE_DETECT=y
# end of Serial flasher config

#
# LWIP Config
#
CONFIG_LWIP_IPV6_AUTOCONFIG=y
# end of LWIP Config
```

## sys/net/vaina/Kconfig
```kconfig
menuconfig KCONFIG_MODULE_VAINA
    bool "VAINA configuration"
    default n
    help
        Configure VAINA client.

if KCONFIG_MODULE_VAINA

config VAINA_PORT
    int "VAINA UDP port"
    default 1337
    range 0 65535
    help
        VAINA UPD port

config VAINA_MCAST_ADDR
    string "VAINA multicast address"
    default "ff15::42"
    help
        VAINA default multicast address

endif
```

## test/sdkconfig.defaults
```kconfig
#
# ESP-IDF SDK Configuration File.
# Locha Mesh - Turpial Firmware Project Configuration
#

#
# Partition Table
#
CONFIG_PARTITION_TABLE_CUSTOM=y
CONFIG_PARTITION_TABLE_CUSTOM_FILENAME="../partitions_custom.csv"
CONFIG_PARTITION_TABLE_FILENAME="../partitions_custom.csv"
# end of Partition Table

#
# HTTPS Server Config
#
CONFIG_ESP_HTTPS_SERVER_ENABLE=y
CONFIG_HTTPD_WS_SUPPORT=y
# end of HTTPS Server Config

#
# Serial Flasher Config
#
CONFIG_ESPTOOLPY_BAUD_OTHER_VAL=115200
CONFIG_ESPTOOLPY_FLASHSIZE_4MB=y
CONFIG_ESPTOOLPY_FLASHSIZE="4MB"
CONFIG_ESPTOOLPY_FLASHSIZE_DETECT=y
# end of Serial flasher config

#
# LWIP Config
#
CONFIG_LWIP_IPV6_AUTOCONFIG=y
CONFIG_LWIP_SLIP_SUPPORT=y
CONFIG_LWIP_SLIP_RX_FROM_ISR=y
# end of LWIP Config
```

## wifi/Kconfig
```kconfig
menu "Turpial Firmware configuration"

config TURPIAL_AP_SSID
    string "Turpial AP SSID"
    default "Turpial_"
    help
        Turpial AP SSID. If not specified, by default an SSID of
        Turpial_<ESP32 MAC> will be used.

config TURPIAL_AP_PASSWORD
    string "Turpial AP password"
    default "mypassword"
    help
        Turpial AP password.

config TURPIAL_GLOBAL_ADDR
    string "Turpial default IPv6 global address"
    default "2001:db8::1"
    help
        Turpial default IPv6 global address

config TURPIAL_GLOBAL_PREFIX
    int "Prefix in bits for Turpial global address"
    default 64
    help
        Global prefix in bits for Turpial global address

endmenu
```
